/*@!Encoding:65001*/
includes
{
  
}

variables
{
    // canoe -> android
    dword gTxSocket;
    char gAndroidIp[16] = "127.0.0.1";
    long gAndroidPort = 5000;

    int gSpeed = 0;
    int gSpeedLineIdx = 0;
    int gIgnitionState = 0;
    int gProgressStateIdx = 0;
    char gDate[50] = "";
    char gTime[50] = "";

    // android -> canoe
    dword gServerSocket;
    dword gClientSocket;

    char gRxBuffer[256];
}

on start
{
  // canoe -> android
  gTxSocket = tcpOpen(0, 0);
  tcpConnect(gTxSocket, ipGetAddressAsNumber(gAndroidIp), gAndroidPort);

  write("Android TCP connect request sent");

  // android -> canoe
  gServerSocket = TcpOpen(0, 6000);
  TcpListen(gServerSocket);

  write("AAOSBridge TCP server started");
}

void sendDashboardState()
{
  char payload[256];

  snprintf(
    payload,
    elcount(payload),
    "speed=%d;speed_line_idx=%d;ignition_state=%d;progress_state_idx=%d;date=%s;time=%s\n",
    gSpeed,
    gSpeedLineIdx,
    gIgnitionState,
    gProgressStateIdx,
    gDate,
    gTime
  );

  TcpSend(gTxSocket, payload, strlen(payload));
  write("send to android: %s", payload);
}

on signal Input::Speed::Veh_VehicleSpeed::Sig_VehicleSpeed
{
  gSpeed = this;
  gSpeedLineIdx = @sysvar::UI_Status::dashboard_speed;
  sendDashboardState();
}

on sysvar UI_Status::start_up_btn
{
  gIgnitionState = @this;
  sendDashboardState();
}

on sysvar OTA::ProgressStateIndex
{
  gProgressStateIdx = @this;
  sendDashboardState();
}

on sysvar UI_Status::cur_date
{
  SysGetVariableString(
    sysvar::UI_Status::cur_date,
    gDate,
    elcount(gDate)
  );
  sendDashboardState();
}

on sysvar UI_Status::cur_time
{
  SysGetVariableString(
    sysvar::UI_Status::cur_time,
    gTime,
    elcount(gTime)
  );
  sendDashboardState();
}

// receive
void OnTcpListen(dword socket, long result)
{
  if (result == 0)
  {
    gClientSocket = tcpAccept(socket);

    write("Android client connected");

    tcpReceive(
      gClientSocket,
      gRxBuffer,
      elcount(gRxBuffer)
    );
  }
  else
  {
    write("tcpListen failed. result=%d", result);
  }
}

/*
 * Android에서 보낸 데이터 수신
 */
void OnTcpReceive(
  dword socket,
  long result,
  dword address,
  dword port,
  char buffer[],
  dword size
)
{
  if (result == 0)
  {
    write("received from android: %s", buffer);
    if (strstr(buffer, "command=download") >= 0 && strstr(buffer, "target=smart_light") >= 0)
    {
      @Button::down_btn_click = 1;
      write("Smart Light update requested");
    }

    tcpReceive(
      socket,
      gRxBuffer,
      elcount(gRxBuffer)
    );
  }
  else write("tcpReceive failed. result=%d", result);
}